#include <avr/interrupt.h>
#include <avr/io.h>
/* We define in this line the frequency in wich the microcontroler will work, in this case it is 16MHz with the use of a crystal oscillator*/
#define F_CPU 16000000UL

/*These 2 global variables are used to control motors speed*/
volatile unsigned char motorF = 255;
volatile unsigned char motorT = 10;
volatile unsigned char contador = 0;

void init(void){
    /*Motors are controled by pwm, OC2A and OC2B are used as output
    in this 2 ports. PORTB5 and PORTD3 used as output*/
    DDRB |= (1 << DDB3);
    DDRD |= (1 << DDD3) | (1<<DDD0);
    /* led controlo infravermelhos */
    DDRD |= (1 << PD7);
    PORTD = (1 << PORTD7);

    /*INfravermelhos*/
    DDRD &= ~(1 << PD4);
    


    /*PWM for the motor is generated by PWM and is controled by
    the TC2 wich is initialized here*/
    TCCR2A |= (1 << COM2A1) | (1 << WGM21) | (1 << WGM20) | (1 << COM2B1);
    TCCR2B |= (1 << CS22)   | (1 << CS20);
    TIMSK2 |= (1 << OCIE2A) | (1 << OCIE2B);

    /*The TC0 will be used to make a LED blink at 1Hz
    PortD1 will also be initialized as input, this initialization
    gives us a 5ms counter*/
    OCR0A = 77;
    TCCR0A |= (1 << COM0A1) | (1 << COM0A0) | (1 << WGM01);
    TCCR0B |= (1 << FOC0A)  |  (1 << CS02)  | (1 << CS00);
    TIMSK0 |= (1 << OCIE0A);
  
    /*The TC1 will be used to control the servo with will be used
    to drive the car*/
    DDRB |= (1 << PB1);
    TCCR1A |= (1 << COM1A1) | (1 << WGM11);
    TCCR1B |= (1 << WGM13) | (1 << WGM12) | (1 << CS11) | (1 << CS10);
    ICR1 = 4999;
    // 16M/64 = 250K -- 1/250K = 4us 0.01/4us = 250
    OCR1A = 130;
    OCR1A = 1332;
    
    
    /*Enables interrupts*/
    sei();
}

/*As we have a 5ms timer/counter it will count to 100
to turn the led on or off giving us the 1Hz blink*/
ISR(TIMER0_COMPA_vect)
{
  contador++;
  if(contador==100){
    PORTD ^= ( 1 << PORTD0);
    contador= 0; 
  }
}
ISR(TIMER2_COMPA_vect)
{
  OCR2A = motorF;
}

ISR(TIMER2_COMPB_vect)
{
  OCR2B = motorT;
}

int main(){
    init();
    while(1){
    if (PIND & (1<< PD4 ))  PORTD &= ~(1 << PORTD7); //led liga no preto
    else PORTD |= (1 << PORTD7);
    }
}
