/*Avr Libraries for interrupts and IO ports*/
#include <avr/interrupt.h>
#include <avr/io.h>

/* We define in this line the frequency in wich the microcontroler will work, in this case it is
 16MHz with the use of a crystal oscillator*/
#define F_CPU 16000000UL
/*Here we give names to the ports so its easier to know witch motor
we are controlling*/
#define speedL OCR2A
#define speedR OCR2B
/*This variable is used so we can give a % of speed we want the motor to operate*/
#define motor(valor) ((255*valor)/100)

volatile unsigned char contador = 0;
/*Motor is controled using a switch case so here we define names for it*/
#define centerstate 0
#define rightstate 1
#define leftstate 2 
#define start 3
volatile unsigned char state;
volatile unsigned char ldr;
/*We give here the values to define the servo directions*/
int direita = 295;
int esquerda = 455;
int centro = 375;
 
/*As we have a 5ms timer/counter it will count to 100
to OCR1A the led on or off giving us the 1Hz blink*/
ISR(TIMER0_COMPA_vect)
{
    contador++;
  if(contador==100){
    PORTD ^= ( 1 << PORTD4);
    contador= 0; 
    ler_AD();
    if(ldr>=125) 
      PORTD |= ( 1 << PORTD5);
    else
      PORTD = ~( 1 << PORTD5);
  }
}

ISR(TIMER0_COMPB_vect){
}

ISR(TIMER2_COMPA_vect)
{ 
}

ISR(TIMER2_COMPB_vect)
{
}

void init(void){
    /*Motors are controled by pwm, OC2A and OC2B are used as output
    in this 2 ports. PORTB3 and PORTD3 used as output*/
    DDRB |= (1 << DDB3);
    DDRD |= (1 << DDD3);
    DDRD |= (1 << DDD4);
    DDRD |= (1 << DDD5);
    /*Definition of LDR port to ADC1*/
    DDRC &= 0b11111101;
    /*Servo*/
    DDRB |= (1 << PB1);
    /*Motor Control*/
    DDRB |= (1 << PB5) | ( 1 << PB4) | (1 << PB0);
    DDRD |= (1 << PD7);
    /*Initialization of the Infrared Sendors*/
    DDRD &= 0b11111000;

		/*The ADC converter wich will be used is the ADC1 and a division factor of 64*/
		ADMUX =  0b00100001;
		ADCSRA = 0b10000110;
    /*Speed for the motor is controled by PWM and is generated by
    the TC2 wich is initialized here*/
    TCCR2A |= (1 << COM2A1) | (1 << WGM21) | (1 << WGM20) | (1 << COM2B1);
    TCCR2B |= (1 << CS22) | (1 << CS20);
    TIMSK2 |= (1 << OCIE2A) | (1 << OCIE2B);
    /*The TC0 will be used to make a LED blink at 1Hz*/
    OCR0A = 77;
     OCR0B = 77;
    TCCR0A |= (1 << COM0A1) | (1 << COM0A0)| (1 << WGM01);
    TCCR0B |= (1 << FOC0A)  | (1 << FOC0B) | (1 << CS02)  | (1 << CS00);
    TIMSK0 |= (1 << OCIE0A);
    /*The TC1 will be used to control the servo with will be used
    to steer the car*/
    TCCR1A |= (1 << COM1A1) | (1 << WGM11);
    TCCR1B |= (1 << WGM13) | (1 << WGM12) | (1 << CS11) | (1 << CS10);
    ICR1 = 4999;


    OCR1A=  centro;
    state = start;
    /*Enables interrupts*/
    sei();
}

/*13 IN2 e 12 IN1 para motor direita*/
/*7 IN1 e 8 IN2 esquerda*/
void frente(void){
  PORTD |= (1 << PORTD7);
  PORTB |= (1 << PORTB4);
  PORTB &= ~(1 << PORTB0);
  PORTB &= ~(1 << PORTB5);
}
void travar(void){
  PORTB |= (1 << PORTB0);
  PORTB |= (1 << PORTB5);
  PORTD |= (1 << PORTD7);
  PORTB |= (1 << PORTB4);
}
void tras(void){

  PORTB |= (1 << PORTB0);
  PORTD &= ~(1 << PORTD7);
  PORTB &= ~(1 << PORTB4);
  PORTB |= (1 << PORTB5);
}
void pontomorto(void){
  PORTD &= ~(1 << PORTD7);
  PORTB &= ~(1 << PORTB0);
  PORTB &= ~(1 << PORTB4);
  PORTB &= ~(1 << PORTB5);
}
void left(void){
  OCR1A = esquerda;
}
void right(void){
  OCR1A = direita;
}
void center(void){
  OCR1A = centro;
}
void ler_AD(void){
	ADCSRA |= (1<<6);  /*Starts reading the ADC*/
	while ((ADCSRA & (1<<6)) != 0); /*Waits for the ADC to finish reading*/
	ldr = ADCH; /*Stores the value of the ADCH ( Results are fixed at the left ) */
}

int main(){
    init();
    while(1){
    estadomaquina();
  }
}
void estadomaquina(){
  switch(state){
    case start:
      if((PIND | 0b11111010) == 0b11111010){ //Maquina liga
        frente(); 
        speedL = motor(20);
        speedR = motor(20);
        center();
        state = centerstate;
      }
      break;
    case centerstate:
      if((PIND | 0b11111010) == 0b11111110) { //Esquerda OFF Direita ON - vira a esquerda
        left();
        speedL = motor(18);
        speedR = motor(20);
        state = leftstate;
      }
      if((PIND | 0b11111010) == 0b11111011) { //Direita OFF Esquerda ON - vira direita
        right();
        speedR = motor(18);
        speedL = motor(20);
        state = rightstate;
      }
      break;
    case leftstate:
      if((PIND | 0b11111010) == 0b11111011) { //volta ao normal
        center();
        speedR = motor(20);
        speedL = motor(20);
        state = centerstate;
      }
      break;
    case rightstate:
      if((PIND | 0b11111010) == 0b11111110) { //volta ao normal
        center();
        speedL = motor(20);
        speedR = motor(20);
        state = centerstate;
      }
      break;
  }
}
