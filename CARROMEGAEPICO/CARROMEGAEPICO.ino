#include <avr/interrupt.h>
#include <avr/io.h>

/* We define in this line the frequency in wich the microcontroler will work, in this case it is 16MHz with the use of a crystal oscillator*/
#define F_CPU 16000000UL

/*Here we give names to the ports so its easier to know witch thing
we are controlling*/

#define speedL OCR2A
#define speedR OCR2B
#define turn OCR1A
#define motor(valor) ((255*valor)/100)
#define sensorL PORTD4
#define sensorR PORTD2

/*These 2 global variables are used to control motors speed*/


volatile unsigned char contador = 0;
volatile unsigned int counter = 0;
volatile unsigned char vira = 0;
char forward = 0;
char backward = 1;
char stoped = 2;
char direita = 475;
char esquerda = 275;
char centro = 375;
volatile unsigned char estado = stoped;

/*As we have a 5ms timer/counter it will count to 100
to turn the led on or off giving us the 1Hz blink*/
ISR(TIMER0_COMPA_vect)
{
  contador++;
  if(contador==100){
    PORTD ^= ( 1 << PORTD0);
    contador= 0; 
  }
}
ISR(TIMER0_COMPB_vect){
  if(counter >= 1)
    counter ++;
  if(counter == 100)
    counter = 0;
}
ISR(TIMER2_COMPA_vect)
{
  speedL = motor(25);
}

ISR(TIMER2_COMPB_vect)
{
  speedR = motor(25);
}

void init(void){
    /*Motors are controled by pwm, OC2A and OC2B are used as output
    in this 2 ports. PORTB3 and PORTD3 used as output*/
    DDRB |= (1 << DDB3);
    DDRD |= (1 << DDD3);
    /*Blinking led at 1Hz*/
    DDRD |= (1<<DDD0);
    /*Initialization of the Infrared Sendor*/
    DDRD &= ~(1 << PD4);
    DDRD &= ~(1 << PD2);
    /*PWM for the motor is generated by PWM and is controled by
    the TC2 wich is initialized here*/
    TCCR2A |= (1 << COM2A1) | (1 << WGM21) | (1 << WGM20) | (1 << COM2B1);
    TCCR2B |= (1 << CS22)   | (1 << CS20);
    TIMSK2 |= (1 << OCIE2A) | (1 << OCIE2B);
    /*The TC0 will be used to make a LED blink at 1Hz
    PortD1 will also be initialized as input, this initialization
    gives us a 5ms counter*/
    OCR0A = 77;
    TCCR0A |= (1 << COM0A1) | (1 << COM0A0) | (1 << WGM01);
    TCCR0B |= (1 << FOC0A)  |  (1 << CS02)  | (1 << CS00);
    TIMSK0 |= (1 << OCIE0A);
    /*The TC1 will be used to control the servo with will be used
    to drive the car*/
    DDRB |= (1 << PB1);
    TCCR1A |= (1 << COM1A1) | (1 << WGM11);
    TCCR1B |= (1 << WGM13) | (1 << WGM12) | (1 << CS11) | (1 << CS10);
    ICR1 = 4999;
    // 16M/64 = 250K -- 1/250K = 4us 0.01/4us = 250

    /*Controlo dos motores*/
    DDRB |= (1 << PB5) | ( 1 << PB4) | (1 << PB0);
    DDRD |= (1 << PD7);

     
    /*Enables interrupts*/
    sei();
}

/*13 IN2 e 12 IN1 para motor direita*/
/*7 IN1 e 8 IN2 esquerda*/
void frente(void){
    PORTB |= (1 << PORTB0);
    PORTB |= (1 << PORTB5);
    PORTD &= ~(1 << PORTD7);
    PORTB &= ~(1 << PORTB4);
}
void travar(void){
    PORTB |= (1 << PORTB0);
    PORTB |= (1 << PORTB5);
    PORTD |= (1 << PORTD7);
    PORTB |= (1 << PORTB4);
}
void tras(void){
  PORTD |= (1 << PORTD7);
  PORTB |= (1 << PORTB4);
  PORTB &= ~(1 << PORTB0);
  PORTB &= ~(1 << PORTB5);
}
void pontomorto(void){
  PORTD &= ~(1 << PORTD7);
  PORTB &= ~(1 << PORTB0);
  PORTB &= ~(1 << PORTB4);
  PORTB &= ~(1 << PORTB5);
}
void left(void){
  turn = esquerda;
  while(sensorL == 1 && sensorR == 0);
  //turn = direita;
  //counter = 0;
 // while(sensorL == 0 && sensorR == 1);
}
void right(void){
  turn = direita;
//while(sensorL == 0 && sensorR == 1);
 //turn = esquerda;
 //while(sensorL == 1 && sensorR == 0);
}
int main(){
    init();
    while(1){
    if(sensorL == 0 && sensorR == 0) {
      if(estado == stoped) frente();
      turn = centro; 
    }
    if(sensorL == 1 && sensorR == 0) 
      left();
    if(sensorL == 0 && sensorR == 1)
      right();
  }
}
